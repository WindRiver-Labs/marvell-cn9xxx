## conf/layer.conf
```bitbake
# We have a conf and classes directory, add to BBPATH
BBPATH =. "${LAYERDIR}:"

# We have a packages directory, add to BBFILES
BBFILES += " ${LAYERDIR}/recipes-*/*/*.bb "
BBFILES += " ${LAYERDIR}/recipes-*/*/*.bbappend "

BBFILE_COLLECTIONS += "wr-marvell-cn9xxx"
BBFILE_PATTERN_wr-marvell-cn9xxx := "^${LAYERDIR}/"
BBFILE_PRIORITY_wr-marvell-cn9xxx = "7"

# This should only be incremented on significant changes that will
# cause compatibility issues with other layers
LAYERVERSION_wr-marvell-cn9xxx = "1"

LAYERDEPENDS_wr-marvell-cn9xxx = "core wrlinux"
LAYERSERIES_COMPAT_wr-marvell-cn9xxx = "warrior zeus wrl"
```

## conf/machine/marvell-cn91xx.conf
```bitbake
#@TYPE: Machine
#@NAME: marvell-cn91xx
#@DESCRIPTION: Machine configuration for Marvell CN9130 SoC

DEFAULTTUNE = "cortexa72"
require conf/machine/include/tune-cortexa72.inc

MACHINE_FEATURES = "ext3 pci usbgadget usbhost vfat"

KERNEL_IMAGETYPE = "Image"
KERNEL_DEVICETREE = "marvell/cn9130-db.dtb"

SERIAL_CONSOLES ?= "115200;ttyS0"
SERIAL_CONSOLES_CHECK ?= "${SERIAL_CONSOLES}"

IMAGE_FSTYPES += "tar.bz2"

# multilib support
MULTILIBS ?= "multilib:lib32"
DEFAULTTUNE_virtclass-multilib-lib32 ?= "armv7athf-neon"
EXTRA_IMAGECMD_jffs2 = "--pad --no-cleanmarkers --eraseblock=128"

MACHINE_EXTRA_RRECOMMENDS = " kernel-modules kernel-devicetree"
IMAGE_FSTYPES += "tar.bz2 wic wic.bmap"
WKS_FILE ?= "cn91xx-sdimage-bootpart.wks"
do_image_wic[depends] += "mtools-native:do_populate_sysroot dosfstools-native:do_populate_sysroot"
IMAGE_INSTALL_append = " kernel-devicetree kernel-image-image"
IMAGE_BOOT_FILES ?= " Image cn9130-db.dtb"

PREFERRED_PROVIDER_virtual/kernel ??= "linux-yocto"
```

## conf/machine/marvell-cn96xx.conf
```bitbake
#@TYPE: Machine
#@NAME: marvell-cn96xx
#@DESCRIPTION: Machine configuration for Marvell CN96xx SoC

# So far there is no "octeontx2" target processor support in gcc
DEFAULTTUNE = "octeontx2"
require conf/machine/include/arm/armv8-2a/tune-octeontx2.inc

MACHINE_FEATURES = "ext3 pci usbhost vfat"

KERNEL_IMAGETYPE = "Image"

SERIAL_CONSOLES ?= "115200;ttyAMA0"
SERIAL_CONSOLES_CHECK ?= "${SERIAL_CONSOLES}"

IMAGE_FSTYPES += "tar.bz2"

MACHINE_EXTRA_RRECOMMENDS = " kernel-modules"
IMAGE_FSTYPES += "tar.bz2 wic wic.bmap"
IMAGE_TYPEDEP_wic = "tar.bz2"
WKS_FILE ?= "cn96xx-sdimage-bootpart.wks"
do_image_wic[depends] += "mtools-native:do_populate_sysroot dosfstools-native:do_populate_sysroot"
IMAGE_INSTALL_append = " kernel-image-image"
IMAGE_BOOT_FILES ?= " Image"

PREFERRED_PROVIDER_virtual/kernel ??= "linux-yocto"
PREFERRED_VERSION_linux-yocto ?= "5.10%"

# Its u-boot only supports FIT image
CONVERSION_CMD_u-boot_marvell-cn96xx = "mkimage -f auto -A ${UBOOT_ARCH} -O linux -T ramdisk -C none -n ${IMAGE_NAME} -d ${IMAGE_NAME}${IMAGE_NAME_SUFFIX}.${type} ${IMAGE_NAME}${IMAGE_NAME_SUFFIX}.${type}.u-boot"

# For ostree
# No u-boot
OSTREE_BOOTLOADER_INCLUDE ?= ""
OSTREE_SD_UBOOT_WIC1 ?= ""
# Reserve 8M for BLM (Counted by Sector size which is 512 bytes in usual)
OSTREE_FDISK_BLM ?= "16384"
OSTREE_SD_BOOT_ALIGN ?= "16384"

INITRAMFS_IMAGE ??= ""
IMAGE_BOOT_FILES_append = " ${@bb.utils.contains('DISTRO_FEATURES', 'ostree', '${INITRAMFS_IMAGE}-${MACHINE}.${INITRAMFS_FSTYPES};initramfs boot.scr boot.itb', '', d)} \
"

SKIP_SCRIPT_FDT ?= "yes"

OSTREE_BOOTSCR_PRECMD ?= " \
setenv no_menu yes; setenv fdt_addr \$fdtaddr; \
setenv console ttyAMA0; setenv initrd_addr 0x50000000; \
setenv no_setexpr yes; setenv loadaddr 0x040080000; \
setenv loadaddr1 0x040080001; setenv loadaddr2 0x040080002; \
setenv bct_addr 0x040080200; setenv bct_addr1 0x040080201; \
setenv skip_script_fdt ${SKIP_SCRIPT_FDT}; \
"

OSTREE_KERNEL ?= "Image"
# Don't set a default dtb for the board, its u-boot load it into the fdtaddr
# automatically
DEFAULT_DTB ?= ""
OSTREE_COPY_IMAGE_BOOT_FILES = "1"
OSTREE_UBOOT_CMD ?= "booti"

# For ustart.img
OSTREE_NETINST_DEV ?= "/dev/mmcblk0,/dev/sda,/dev/vda"
OSTREE_NETINST_ARGS ?= "${OSTREE_CONSOLE} bl=ufsd rdinit=/install instdev=${OSTREE_NETINST_DEV} instname=wrlinux instbr=\$BRANCH insturl=\$URL instab=${OSTREE_USE_AB} instsf=1 instdate=BUILD_DATE"
```
